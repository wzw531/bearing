#include "dsp.h"
#include "usart.h"

/************************************--FFT--*****************************************************/
#define FFT_LENGTH  1024
arm_cfft_radix2_instance_f32 s;
float fft_inputbuf[FFT_LENGTH * 2]={
-0.042672    ,  0,
-0.026067    ,  0,
-0.029399    ,  0,
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-0.008493    ,  0
};
float fft_outputbuf[FFT_LENGTH];


void FFT_test(void)
{
	arm_cfft_radix2_init_f32(&s, FFT_LENGTH, 0, 1);
	/* 生成输入数据 */
	for (int i=0; i<FFT_LENGTH; i++)
    {
//      fft_inputbuf[2 * i] = 100 +
//                            10 * arm_sin_f32(2 * PI * i / FFT_LENGTH) +
//                            30 * arm_sin_f32(2 * PI * i * 4 / FFT_LENGTH) +
//                            50 * arm_cos_f32(2 * PI * i * 8 / FFT_LENGTH);
//      fft_inputbuf[2 * i + 1] = 0;
		printf("%f\r\n",fft_inputbuf[2 * i]);
    }
	/* FFT计算 */		
	arm_cfft_radix2_f32(&s, fft_inputbuf);
			
	/* 对FFT计算结果取模并通过串口输出 */
    arm_cmplx_mag_f32(fft_inputbuf, fft_outputbuf, FFT_LENGTH);
    for (int i=0; i<FFT_LENGTH; i++)
    {
        //printf("fft_outputbuf[%d]:%f\r\n", i, fft_outputbuf[i]);
		printf("%f\r\n",fft_outputbuf[i]);
    }		
}

/************************************--IIR滤波--*****************************************************/
arm_biquad_casd_df1_inst_f32 IIR_S;

//二阶节的个数，等于设计滤波器阶数除以2向上取整
uint8_t IIR_numStages=10;

//滤波器系数，每个二阶节包含5个，对应b0,b1,b2,a1,a2
float32_t  IIR_pCoeffs[50]={
1,  2,  1 ,  0.765804326619723640945380793709773570299, -0.866453653846503635271858456690097227693,
1,  2,  1 ,  0.676564059665551664757288108376087620854, -0.648953155955530380794016309664584696293,
1,  2,  1 ,  0.608306338440895100205807466409169137478, -0.482592287056627544661324691332993097603,
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1,  2,  1 ,  0.429826195615057915500045737644541077316, -0.047592244439017883372855521884048357606	
};

//状态暂存，每个二阶节包含4个状态，对应x[n-1],x[n-2],y[n-1],y[n-2],
float32_t  IIR_pState[40]={0.0f};

//原始数据
float32_t  IIR_pSrc[1024]={
-0.042672   ,
-0.026067   ,
-0.029399   ,
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-0.008493   ,
//0.002233    ,
};

//滤波结果
float32_t  IIR_pDst[1024]={0.0f};

//分包处理，包的大小
uint32_t IIR_blockSize=1024;

//尺度系数，输出结果需乘以该系数
float IIR_Scale_Values=6.030608945523800e-08f;


void IIRfilter_test(void)
{
	
//	for(int i=0;i<256;i++)
//	{
//		pSrc[i]=50.f+300.f*arm_sin_f32(100.f*PI*i/3200.f)+100.f*arm_sin_f32(700.f*PI*i/3200.f);
//	}
	
	arm_biquad_cascade_df1_init_f32(&IIR_S,IIR_numStages,IIR_pCoeffs,IIR_pState);
	
	arm_biquad_cascade_df1_f32(&IIR_S,IIR_pSrc,IIR_pDst,IIR_blockSize);
	
	for(int i=0;i<1024;i++)
	{
		printf("%f,%f\r\n",IIR_pSrc[i],IIR_pDst[i]*IIR_Scale_Values);
	}
	
}

/************************************--FIR滤波--*****************************************************/
//按输出抽取FIR的实例化结构体
arm_fir_decimate_instance_f32 FIR_S;

//滤波器系数的个数
uint16_t FIR_numTaps=33;

//抽取因子
uint8_t FIR_M=1;

//滤波器系数
float32_t FIR_pCoeffs[33]={
   -0.0009088495149248, -0.00221537126802,-3.854937610386e-05, 0.009557491239271,
    0.02144535964532,  0.02047421072222,-0.0007014426311003, -0.02291914714057,
   -0.01480282907922,  0.02299253749362,  0.04147644433902,-0.002114233109641,
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    0.02144535964532, 0.009557491239271,-3.854937610386e-05, -0.00221537126802,
  -0.0009088495149248
};

//状态变量暂存
float32_t FIR_pState[2080]={0.0f};
  
//包处理大小
uint32_t FIR_blockSize=1024;
  
//原始输入
float32_t FIR_pSrc[1024]={
-0.042672   ,
-0.026067   ,
-0.029399   ,
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0.005039    ,
//0.041703    ,
};

//滤波输出，大小=blockSize/M
float32_t FIR_pDst[1024]={0.0f};

void FIRfilter_test(void)	
{
//	for(int i=0;i<200;i++)
//	{
//		pSrc[i]=50.f+300.f*arm_sin_f32(100.f*PI*i/3200.f)+100.f*arm_sin_f32(700.f*PI*i/3200.f);
//		pSrc[i]=50.f+300.f*arm_sin_f32(100.f*PI*i/200.f)+100.f*arm_sin_f32(400.f*PI*i/200.f);
//	}
	
	arm_fir_decimate_init_f32(&FIR_S,FIR_numTaps,FIR_M,FIR_pCoeffs,FIR_pState,FIR_blockSize);
	
	arm_fir_decimate_f32(&FIR_S,FIR_pSrc,FIR_pDst,FIR_blockSize);
	
	for(int i=0;i<1024;i++)
	{
		printf("%f,%f\r\n",FIR_pSrc[i],FIR_pDst[i]);
	}
}



/************************************--特征值计算--*****************************************************/
uint32_t blocksize=12;
float32_t psrc[12]={2,5,6,9,8,4,5,6,32,2,2,3};//测试数据
float32_t pResult={0};                    //峰值
float32_t rmsResult={0};                  //均方根
float32_t meanResult={0};                 //均值
float32_t numerator={0};                  //峭度分子
float32_t denominator={0};                //峭度分母
float32_t kurtosis={0};                   //峭度
void StatisticsFunctions_test(void)
{
	arm_max_no_idx_f32(psrc,blocksize,&pResult);
	printf("%f\r\n",pResult);
	
	arm_rms_f32(psrc,12,&rmsResult);
	printf("%f\r\n",rmsResult);
	
	arm_mean_f32(psrc,12,&meanResult);
	printf("%f\r\n",meanResult);
	
	for(int i=0;i<12;i++)
	{
		numerator+=(psrc[i]-meanResult)*(psrc[i]-meanResult)*(psrc[i]-meanResult)*(psrc[i]-meanResult);
		denominator+=(psrc[i]-meanResult)*(psrc[i]-meanResult);
		printf("%f,%f\r\n",numerator,denominator);
	}
	numerator=numerator/12;
	denominator=denominator/12;
	denominator=denominator*denominator;
	kurtosis=numerator/denominator;
	printf("%f\r\n",kurtosis);
}		

